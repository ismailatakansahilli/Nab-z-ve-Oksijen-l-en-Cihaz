// https://github.com/olikraus/u8glib/wiki/fontsize
// https://cuneyt.aliustaoglu.biz/tr/u8glib-ile-arduino-uno-uzerinden-olede-fotograf-yuklemek/

#include "MAX30100_PulseOximeter.h"
 #include "Wire.h"
#include "U8glib.h"

int sayac = 0;
int heartRate;
int sp02;
bool durum=false;


U8GLIB_SSD1306_128X64 u8g(U8G_I2C_OPT_NONE|U8G_I2C_OPT_DEV_0);
PulseOximeter pox;
 
const unsigned char hearpulse [] U8G_PROGMEM = {
0x00, 0x00, 0x00, 0x00, 0x00, 0x00, 0x00, 0x00, 0x00, 0x00, 0x00, 0x00, 0x00, 0x00, 0x00, 0x00,
0x7C, 0x00, 0x3E, 0x00, 0x03, 0xFF, 0x00, 0xFF, 0xC0, 0x07, 0x01, 0xC3, 0x80, 0xE0, 0x1C, 0x00,
0x66, 0x00, 0x38, 0x38, 0x00, 0x3C, 0x00, 0x1C, 0x30, 0x00, 0x18, 0x00, 0x0C, 0x60, 0x06, 0x00,
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0x00, 0x00, 0x00, 0x00, 0x00, 0x00, 0x00, 0x00, 
};

const unsigned char ritm [] U8G_PROGMEM = {
0x00, 0x00, 0x00, 0x00, 0x00, 0x00, 0x00, 0x00, 0x00, 0x00, 0x00, 0x00, 0x00, 0x00, 0x00, 0x00,
0x7C, 0x00, 0x3E, 0x00, 0x03, 0xFF, 0x00, 0xFF, 0xC0, 0x07, 0x01, 0xC3, 0x80, 0xE0, 0x1C, 0x00,
0x66, 0x00, 0x38, 0x38, 0x00, 0x3C, 0x00, 0x1C, 0x30, 0x00, 0x18, 0x00, 0x0C, 0x60, 0x00, 0x00,
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0x00, 0x00, 0x00, 0x00, 0x00, 0x00, 0x00, 0x00, 
};

const unsigned char barnak [] U8G_PROGMEM = {
0x00, 0x00, 0x01, 0xF0, 0x00, 0x00, 0x00, 0x00, 0x00, 0x00, 0x0F, 0xFE, 0x00, 0x00, 0x00, 0x00,
0x00, 0x00, 0x3F, 0xFF, 0x80, 0x00, 0x00, 0x00, 0x00, 0x00, 0x78, 0x03, 0xC0, 0x00, 0x00, 0x00,
0x00, 0x00, 0xE0, 0xE0, 0xE0, 0x00, 0x00, 0x00, 0x00, 0x01, 0xC7, 0xFC, 0x70, 0x00, 0x00, 0x00,
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0x00, 0x00, 0x00, 0x01, 0xFF, 0xF0, 0x00, 0x00, 0x00, 0x00, 0x00, 0x00, 0x0F, 0x00, 0x00, 0x00
};
 
void onBeatDetected()
{

}


void draw() {      
            
u8g.setFont(u8g_font_7x13Br); //(u8g_font_7x14B);

u8g.setPrintPos(80,10);
u8g.print((float)getVCC()/10);
u8g.print("V");

u8g.drawStr(0, 10, "Kalp BPM");
u8g.drawStr(0, 44, "Oksijen");

u8g.setFont(u8g_font_helvB14);

u8g.setPrintPos(0,26);
u8g.print(heartRate);

u8g.setPrintPos(0,60);
u8g.print(sp02);
u8g.drawStr(20, 60, "% ");

if(durum)
u8g.drawBitmapP( 66, 20, 5, 40, hearpulse); //40*40
else u8g.drawBitmapP( 66, 20, 5, 40, ritm); //40*40

}

void draw1(void) {      
            
u8g.setFont(u8g_font_7x13Br);      //(u8g_font_7x14B);
u8g.drawStr(48, 15, "Parmak yok!"); 
u8g.drawStr(66, 44, "Pulse");
u8g.drawStr(62, 54, "Oximeter");
u8g.drawStr(62, 64, "Max30100");
//u8g.setFont(u8g_font_cursor); u8g.drawStr(55, 18 ,"\x5B");
u8g.drawBitmapP( 0, 0, 8, 64, barnak);  //64*64
}

int getVCC() {
  //reads internal 1V1 reference against VCC
  #if defined(__AVR_ATmega1284P__)
    ADMUX = _BV(REFS0) | _BV(MUX4) | _BV(MUX3) | _BV(MUX2) | _BV(MUX1);  // For ATmega1284
  #else
    ADMUX = _BV(REFS0) | _BV(MUX3) | _BV(MUX2) | _BV(MUX1);  // For ATmega328
  #endif
  delay(2); // Wait for Vref to settle
  ADCSRA |= _BV(ADSC); // Convert
  while (bit_is_set(ADCSRA, ADSC));
  uint8_t low = ADCL;
  unsigned int val = (ADCH << 8) | low;
  //discard previous result
  ADCSRA |= _BV(ADSC); // Convert
  while (bit_is_set(ADCSRA, ADSC));
  low = ADCL;
  val = (ADCH << 8) | low;
  
  return (((long)1024 * 1100) / val)/100;  
}


         
void setup()
{
Wire.begin();
pox.begin();
pox.setOnBeatDetectedCallback(onBeatDetected); 
}
 
void loop()
{      
  u8g.firstPage();  
  do {  
     pox.update();
     heartRate = pox.getHeartRate();
     sp02      = pox.getSpO2();
        if(heartRate !=0  &&  sp02 !=0){
        draw();} else draw1();
        } while(u8g.nextPage());
  
delay(10);

durum=!durum;
}
